## Documentation/devicetree/bindings/usb/qcom,pmic-tcpm.yaml
```yaml
# SPDX-License-Identifier: (GPL-2.0-only OR BSD-2-Clause)
%YAML 1.2
---
$id: "http://devicetree.org/schemas/usb/qcom,pmic-tcpm.yaml#"
$schema: "http://devicetree.org/meta-schemas/core.yaml#"

title: Qualcomm PMIC TCPM Driver

maintainers:
  - Bryan O'Donoghue <bryan.odonoghue@linaro.org>

description: |
  Qualcomm PMIC Type-C Port Manager Driver

properties:
  compatible:
    enum:
      - qcom,pm8150b-tcpm

  qcom,pmic-tcpm-typec:
    $ref: /schemas/types.yaml#/definitions/phandle
    description:
      A phandle to the typec port hardware driver.

  qcom,pmic-tcpm-pdphy:
    $ref: /schemas/types.yaml#/definitions/phandle
    description:
      A phandle to the type-c pdphy hardware driver.

required:
  - compatible
  - qcom,pmic-tcpm-typec
  - qcom,pmic-tcpm-pdphy

additionalProperties: false

examples:
  - |
    #include <dt-bindings/interrupt-controller/irq.h>
    #include <dt-bindings/usb/pd.h>
    #include <dt-bindings/usb/typec/tcpm/qcom,pmic-usb-typec.h>
    #include <dt-bindings/usb/typec/tcpm/qcom,pmic-usb-pdphy.h>

    pm8150b_tcpm: pmic-tcpm {
        compatible = "qcom,pm8150b-tcpm";

        qcom,pmic-tcpm-typec = <&pm8150b_typec>;
        qcom,pmic-tcpm-pdphy = <&pm8150b_pdphy>;

        connector {
            compatible = "usb-c-connector";

            power-role = "source";
            data-role = "dual";
            self-powered;

            source-pdos = <PDO_FIXED(5000, 3000,
                           PDO_FIXED_DUAL_ROLE |
                           PDO_FIXED_USB_COMM |
                           PDO_FIXED_DATA_SWAP)>;

            port {
                pmic_tcpm_ss_mux: endpoint {
                    remote-endpoint = <&qmp_ss_mux>;
                };
            };
        };
    };

...
```
